## meta-custom_drivers/conf/layer.conf
```bitbake
# We have a conf and classes directory, add to BBPATH
BBPATH .= ":${LAYERDIR}"

# We have recipes-* directories, add to BBFILES
BBFILES += "${LAYERDIR}/recipes-*/*/*.bb \
            ${LAYERDIR}/recipes-*/*/*.bbappend"

BBFILE_COLLECTIONS += "meta-custom_drivers"
BBFILE_PATTERN_meta-custom_drivers = "^${LAYERDIR}/"
BBFILE_PRIORITY_meta-custom_drivers = "6"

LAYERDEPENDS_meta-custom_drivers = "core"
LAYERSERIES_COMPAT_meta-custom_drivers = "dunfell"
```
